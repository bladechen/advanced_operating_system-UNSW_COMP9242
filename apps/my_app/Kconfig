## apps/my_app/Kconfig
```kconfig
#
# Copyright 2014, NICTA
#
# This software may be distributed and modified according to the terms of
# the BSD 2-Clause license. Note that NO WARRANTY is provided.
# See "LICENSE_BSD2.txt" for details.
#
# @TAG(NICTA_BSD)
#

config APP_MY_APP
    bool "My app"
    depends on LIB_SEL4 && HAVE_LIBC && LIB_SOS
    default y
    select HAVE_SEL4_APPS
    help
        my new app
```
